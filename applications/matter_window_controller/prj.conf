## CMakeLists.txt
```
#
# Copyright (c) 2021 Nordic Semiconductor ASA
#
# SPDX-License-Identifier: LicenseRef-Nordic-5-Clause
#

cmake_minimum_required(VERSION 3.20.0)

set(multiprotocol_rpmsg_KCONFIG_ROOT "\\\${ZEPHYR_CONNECTEDHOMEIP_MODULE_DIR}/config/nrfconnect/chip-module/Kconfig.multiprotocol_rpmsg.root")
set(hci_ipc_KCONFIG_ROOT "\\\${ZEPHYR_CONNECTEDHOMEIP_MODULE_DIR}/config/nrfconnect/chip-module/Kconfig.hci_ipc.root")

find_package(Zephyr REQUIRED HINTS $ENV{ZEPHYR_BASE})

project(matter-window-controller)

set(COMMON_ROOT ${ZEPHYR_NRF_MODULE_DIR}/samples/matter/common)
set(NLIO_ROOT ${ZEPHYR_CONNECTEDHOMEIP_MODULE_DIR}/third_party/nlio/repo)
include(${ZEPHYR_CONNECTEDHOMEIP_MODULE_DIR}/config/nrfconnect/app/enable-gnu-std.cmake)
include(${ZEPHYR_CONNECTEDHOMEIP_MODULE_DIR}/src/app/chip_data_model.cmake)

# NORDIC SDK APP START
target_include_directories(app PRIVATE
    src
    ${COMMON_ROOT}/src
    ${NLIO_ROOT}/include
    ${ZEPHYR_CONNECTEDHOMEIP_MODULE_DIR}/zzz_generated/app-common
)

target_sources(app PRIVATE
    src/app_task.cpp
    src/main.cpp
    src/zap-generated/IMClusterCommandHandler.cpp
    src/zap-generated/callback-stub.cpp
    ${COMMON_ROOT}/src/board/led_widget.cpp
    ${COMMON_ROOT}/src/app/task_executor.cpp
    ${COMMON_ROOT}/src/board/board.cpp
    ${COMMON_ROOT}/src/app/matter_init.cpp
    ${COMMON_ROOT}/src/app/matter_event_handler.cpp
)

#if(CONFIG_CHIP_OTA_REQUESTOR)
    target_sources(app PRIVATE ${COMMON_ROOT}/src/dfu/ota/ota_util.cpp)
#endif()

if(CONFIG_NCS_SAMPLE_MATTER_OPERATIONAL_KEYS_MIGRATION_TO_ITS)
    target_sources(app PRIVATE ${COMMON_ROOT}/src/migration/migration_manager.cpp)
endif()

chip_configure_data_model(app
    INCLUDE_SERVER
    BYPASS_IDL
    GEN_DIR src/zap-generated
    ZAP_FILE ${CMAKE_CURRENT_SOURCE_DIR}/src/weather-station.zap
)
# NORDIC SDK APP END
```

## prj.conf
```kconfig
#
# Copyright (c) 2021 Nordic Semiconductor ASA
#
# SPDX-License-Identifier: LicenseRef-Nordic-5-Clause
#

# This sample uses Kconfig.defaults to set options common for all
# samples. This file should contain only options specific for this sample
# or overrides of default values.

# Enable CHIP
CONFIG_CHIP=y
CONFIG_CHIP_ENABLE_PAIRING_AUTOSTART=y
CONFIG_CHIP_PROJECT_CONFIG="src/chip_project_config.h"
# 32781 == 0x800D (matter example of Temperature measurement device as NCS Weather Station)
CONFIG_CHIP_DEVICE_PRODUCT_ID=32781
CONFIG_STD_CPP17=y

# Enable Bluetooth Low Energy
CONFIG_BT_DEVICE_NAME="MatterWinCtr"

# Add support for LEDs, buttons and buzzer
CONFIG_DK_LIBRARY=y
CONFIG_PWM=y

# Configure Thingy:53 sensors
CONFIG_I2C=y
CONFIG_SENSOR=y
CONFIG_BME680=y
CONFIG_ADC=y

# Suspend devices when the CPU goes into sleep
CONFIG_PM_DEVICE=y

# Other settings
CONFIG_IEEE802154_NRF5_RX_STACK_SIZE=8192
CONFIG_THREAD_NAME=y
CONFIG_MPU_STACK_GUARD=y
CONFIG_CHIP_LIB_SHELL=y

# Average Thingy:53 current consumption
CONFIG_AVERAGE_CURRENT_CONSUMPTION=10000

# Increase system workqueue size, as SMP is processed within it
CONFIG_SYSTEM_WORKQUEUE_STACK_SIZE=4096

# 0x0302 (Temp. sensor)
CONFIG_CHIP_DEVICE_TYPE=770
CONFIG_BT_RX_STACK_SIZE=1500

# Configure UART logging and shell
CONFIG_LOG=y
CONFIG_LOG_MODE_DEFERRED=y
CONFIG_LOG_PROCESS_THREAD_STACK_SIZE=1024
CONFIG_LOG_BUFFER_SIZE=8192
CONFIG_LOG_FUNC_NAME_PREFIX_DBG=n
CONFIG_MATTER_LOG_LEVEL_DBG=y
CONFIG_SHELL=y
CONFIG_SHELL_LOG_BACKEND=y

# Configure USB CDC ACM
CONFIG_USB_DEVICE_INITIALIZE_AT_BOOT=n
CONFIG_USB_DEVICE_PRODUCT="Thingy:53 Matter Weather"
CONFIG_USB_DEVICE_PID=0x530D
CONFIG_UART_LINE_CTRL=y
CONFIG_SHELL_BACKEND_SERIAL_INIT_PRIORITY=51

# Use minimal C library instead of the Picolib
#CONFIG_MINIMAL_LIBC=y

#CONFIG_STD_CPP11=y
CONFIG_EDGE_IMPULSE=y
CONFIG_EDGE_IMPULSE_URI="https://developer.nordicsemi.com/nRF_Connect_SDK/EdgeImpulse/nrf_accel_sim-v35.zip; https://buranrgstorageacc.blob.core.windows.net/nrf-connect-sdk-edgeimpulse/nrf_accel_sim-v35.zip"
CONFIG_EI_WRAPPER=y
CONFIG_EI_WRAPPER_DATA_BUF_SIZE=500
CONFIG_FP16=n

CONFIG_ADXL362=y
CONFIG_ADXL362_ACCEL_RANGE_8G=y
CONFIG_ADXL362_ACCEL_ODR_100=y
CONFIG_ADXL362_TRIGGER_GLOBAL_THREAD=y
CONFIG_ADXL362_INACTIVITY_THRESHOLD=0
CONFIG_ADXL362_ACTIVITY_THRESHOLD=110
CONFIG_ADXL362_ABS_REF_MODE=1

CONFIG_ADXL362=y
CONFIG_ADXL362_TRIGGER_GLOBAL_THREAD=y
CONFIG_ADXL362_INTERRUPT_MODE=1
```

## src/app_task.cpp
```c
/*
 * Copyright (c) 2021 Nordic Semiconductor ASA
 *
 * SPDX-License-Identifier: LicenseRef-Nordic-5-Clause
 */

#include "app_task.h"

#include "app/matter_init.h"
#include "app/task_executor.h"
#include "board/board.h"
#include "board/led_widget.h"

#include "input_data.h"
#include <ei_wrapper.h>

#ifdef CONFIG_CHIP_OTA_REQUESTOR
#include "dfu/ota/ota_util.h"
#endif

#ifdef CONFIG_MCUMGR_TRANSPORT_BT
#include "dfu/smp/dfu_over_smp.h"
#endif

#include <app-common/zap-generated/attributes/Accessors.h>
#include <app-common/zap-generated/cluster-objects.h>
#include <app/server/OnboardingCodesUtil.h>
#include <app/server/Server.h>

#include <zephyr/drivers/sensor.h>
#include <zephyr/logging/log.h>

LOG_MODULE_DECLARE(app);

using namespace ::chip;
using namespace ::chip::DeviceLayer;
using namespace ::chip::app;

namespace
{
enum class FunctionTimerMode { kDisabled, kFactoryResetTrigger, kFactoryResetComplete };
enum class LedState { kAlive, kAdvertisingBle, kConnectedBle, kProvisioned };

#if CONFIG_AVERAGE_CURRENT_CONSUMPTION <= 0
#error Invalid CONFIG_AVERAGE_CURRENT_CONSUMPTION value set
#endif

const device *sBme688SensorDev = DEVICE_DT_GET_ONE(bosch_bme680);
const device *adxl362Dev = DEVICE_DT_GET(DT_NODELABEL(adxl362));

} /* namespace */

k_timer sMeasurementsTimer;
constexpr size_t kMeasurementsIntervalMs = 100;
bool isFirstPrediction = true;
bool isPredictionActive = false;

const float kPredictedValueThreshold = 0.8;
const float kAnomalyThreshold = 6;
static const char *anomalyLabel = "anomaly";
static const char *curent_label;
static uint8_t prediction_streak;
const uint8_t kPredictionStreakThreshold = 2;

const char * parseLabel(const char * label) {
	if (strcmp(label, "sine") == 0) {
		return "rotate";
	} else if (strcmp(label, "triangle") == 0) {
		return "up-down";
	} else if (strcmp(label, "idle") == 0) {
		return "idle";
	} else {
		return label;
	}
}

void AppTask::MeasurementsTimerHandler()
{
	int result = sensor_sample_fetch(adxl362Dev);
	if (result != 0) {
		LOG_ERR("Fetching sensor data from ADX failed with: %d", result);
		return;
	}

	struct sensor_value x;
	struct sensor_value y;
	struct sensor_value z;

	float measurements[3];

	result = sensor_channel_get(adxl362Dev, SENSOR_CHAN_ACCEL_X, &x);
	if (result) {
		LOG_ERR("Get x channel failed (%d)", result);
		return;
	}
	result = sensor_channel_get(adxl362Dev, SENSOR_CHAN_ACCEL_Y, &y);
	if (result) {
		LOG_ERR("Get y channel failed (%d)", result);
		return;
	}
	result = sensor_channel_get(adxl362Dev, SENSOR_CHAN_ACCEL_Z, &z);
	if (result) {
		LOG_ERR("Get z channel failed (%d)", result);
		return;
	}

	measurements[0] = sensor_value_to_double(&x);
	measurements[1] = sensor_value_to_double(&y);
	measurements[2] = sensor_value_to_double(&z);

	// LOG_ERR("Measured values: x %f, y %f, z %f", measurements[0], measurements[1], measurements[2]);

	result = ei_wrapper_add_data(measurements, 3);
	if (result) {
		LOG_ERR("Cannot provide input data (err: %d)", result);
		return;
	}
	// int result = sensor_sample_fetch(adxl362Dev);
	// if (result == 0) {
	// 	LOG_ERR("Fetching sensor data ok");
	// } else {
	// 	LOG_ERR("Fetching sensor data from ADX failed with: %d", result);
	// 	return;
	// }

	// struct sensor_value sensorData;
	// result = sensor_channel_get(adxl362Dev, SENSOR_CHAN_ACCEL_XYZ, &sensorData);
	// if (result == 0) {
	// 	LOG_ERR("Getting sensor data ok");
	// } else {
	// 	LOG_ERR("Getting sensor data from ADX failed with: %d", result);
	// }

	if (isPredictionActive) {
		// LOG_ERR("Prediction in progress, cannot start new one");
		return;
	}

	size_t window_shift;
	size_t frame_shift;

	if (isFirstPrediction) {
		window_shift = 0;
		frame_shift = 0;
	} else {
		window_shift = 0;
		frame_shift = 3;
	}

	result = ei_wrapper_start_prediction(window_shift, frame_shift);
	if (result) {
		LOG_ERR("Cannot start prediction (result: %d)", result);
	} else {
		// LOG_ERR("Prediction started...");
		isFirstPrediction = false;
		isPredictionActive = true;
	}
}

void AppTask::UpdateClustersState()
{
	// const int result = sensor_sample_fetch(sBme688SensorDev);

	// if (result == 0) {

	// } else {
	// 	LOG_ERR("Fetching data from BME688 sensor failed with: %d", result);
	// }
}

void AppTask::UpdateLedState()
{
	if (!Instance().mGreenLED || !Instance().mBlueLED || !Instance().mRedLED) {
		return;
	}

	Instance().mGreenLED->Set(false);
	Instance().mBlueLED->Set(false);
	Instance().mRedLED->Set(false);

	switch (Nrf::GetBoard().GetDeviceState()) {
	case Nrf::DeviceState::DeviceAdvertisingBLE:
		Instance().mBlueLED->Blink(Nrf::LedConsts::StatusLed::Disconnected::kOn_ms,
					   Nrf::LedConsts::StatusLed::Disconnected::kOff_ms);
		break;
	case Nrf::DeviceState::DeviceDisconnected:
		Instance().mGreenLED->Blink(Nrf::LedConsts::StatusLed::Disconnected::kOn_ms,
					    Nrf::LedConsts::StatusLed::Disconnected::kOff_ms);
		break;
	case Nrf::DeviceState::DeviceConnectedBLE:
		Instance().mBlueLED->Blink(Nrf::LedConsts::StatusLed::BleConnected::kOn_ms,
					   Nrf::LedConsts::StatusLed::BleConnected::kOff_ms);
		break;
	case Nrf::DeviceState::DeviceProvisioned:
		Instance().mRedLED->Blink(Nrf::LedConsts::StatusLed::Disconnected::kOn_ms,
					  Nrf::LedConsts::StatusLed::Disconnected::kOff_ms);
		Instance().mBlueLED->Blink(Nrf::LedConsts::StatusLed::Disconnected::kOn_ms,
					   Nrf::LedConsts::StatusLed::Disconnected::kOff_ms);
		break;
	default:
		break;
	}
}

static void EIResultReady(int err)
{
	isPredictionActive = false;
	if (err) {
		LOG_ERR("EIResultReady callback returned error (err: %d)", err);
		return;
	}

	// LOG_ERR("EI classification results:");
	// LOG_ERR("======================");

	const char *label;
	const char *newLabel = curent_label;
	float value;
	float anomaly;
	bool increment = true;

	if (ei_wrapper_classifier_has_anomaly()) {
		err = ei_wrapper_get_anomaly(&anomaly);
		if (err) {
			LOG_ERR("Cannot get anomaly (err: %d)", err);
			return;
		} else {
			// LOG_ERR("Anomaly: %.2f", anomaly);
		}
	}

	err = ei_wrapper_get_next_classification_result(&label, &value, NULL);

	if (err) {
		LOG_ERR("Cannot get classification results (err: %d)", err);
	} else {
		// if (anomaly > kAnomalyThreshold) {
		// 	curent_label = anomalyLabel;
		if (value >= kPredictedValueThreshold) {
			newLabel = label;
		} else {
			increment = false;
		}

		if (newLabel != curent_label) {
			if ((!newLabel || !curent_label) || strcmp(newLabel, curent_label)) {
				curent_label = newLabel;
				prediction_streak = 0;
			}
		}

		if (increment) {
			prediction_streak++;
		}

		if (prediction_streak >= kPredictionStreakThreshold) {
			LOG_ERR("Predicted label: %s \t value:  %.2f", parseLabel(curent_label), value);
			prediction_streak = 0;
			curent_label = "idle";
		}
	}
}

CHIP_ERROR AppTask::Init()
{
	/* Initialize Matter stack */
	ReturnErrorOnFailure(Nrf::Matter::PrepareServer());

	/* Set references for RGB LED */
	mRedLED = &Nrf::GetBoard().GetLED(Nrf::DeviceLeds::LED1);
	mGreenLED = &Nrf::GetBoard().GetLED(Nrf::DeviceLeds::LED2);
	mBlueLED = &Nrf::GetBoard().GetLED(Nrf::DeviceLeds::LED3);

	if (!Nrf::GetBoard().Init(nullptr, UpdateLedState)) {
		LOG_ERR("User interface initialization failed.");
		return CHIP_ERROR_INCORRECT_STATE;
	}

	/* Register Matter event handler that controls the connectivity status LED based on the captured Matter network
	 * state. */
	ReturnErrorOnFailure(Nrf::Matter::RegisterEventHandler(Nrf::Board::DefaultMatterEventHandler, 0));

	if (!device_is_ready(sBme688SensorDev)) {
		LOG_ERR("BME688 sensor device not ready");
		return chip::System::MapErrorZephyr(-ENODEV);
	}

#ifdef CONFIG_MCUMGR_TRANSPORT_BT
	Nrf::GetDFUOverSMP().StartServer();
#endif

	return Nrf::Matter::StartServer();
}

CHIP_ERROR AppTask::StartApp()
{
	ReturnErrorOnFailure(Init());

	if (!device_is_ready(adxl362Dev)) {
		LOG_ERR("ADX sensor device not ready");
		return chip::System::MapErrorZephyr(-ENODEV);
	} else {
		LOG_ERR("ADX sensor device ready====================");
	}

	int err = ei_wrapper_init(EIResultReady);

	if (err) {
		LOG_ERR("Edge Impulse wrapper failed to initialize (err: %d)\n", err);
		return chip::System::MapErrorZephyr(-ENODEV);
	} else {
		LOG_ERR("Edge Impulse wrapper initialized successfully");
	}

	// if (ARRAY_SIZE(input_data) < ei_wrapper_get_window_size()) {
	// 	LOG_ERR("Not enough input data");
	// 	return chip::System::MapErrorZephyr(-ENODEV);
	// }

	// if (ARRAY_SIZE(input_data) % ei_wrapper_get_frame_size() != 0) {
	// 	LOG_ERR("Improper number of input samples");
	// 	return chip::System::MapErrorZephyr(-ENODEV);
	// }

	// LOG_ERR("Machine learning model sampling frequency: %zu", ei_wrapper_get_classifier_frequency());
	// LOG_ERR("Labels assigned by the model:");
	// for (size_t i = 0; i < ei_wrapper_get_classifier_label_count(); i++) {
	// 	LOG_ERR("- %s", ei_wrapper_get_classifier_label(i));
	// }

	// size_t cnt = 0;

	// /* input_data is defined in input_data.h file. */
	// err = ei_wrapper_add_data(&input_data[cnt], ei_wrapper_get_window_size());
	// if (err) {
	// 	LOG_ERR("Cannot provide input data (err: %d)", err);
	// 	LOG_ERR("Increase CONFIG_EI_WRAPPER_DATA_BUF_SIZE");
	// 	return chip::System::MapErrorZephyr(-ENODEV);
	// }
	// cnt += ei_wrapper_get_window_size();

	/* Initialize timers */
	k_timer_init(
		&sMeasurementsTimer, [](k_timer *) { Nrf::PostTask([] { MeasurementsTimerHandler(); }); }, nullptr);
	k_timer_start(&sMeasurementsTimer, K_MSEC(kMeasurementsIntervalMs), K_MSEC(kMeasurementsIntervalMs));

	while (true) {
		Nrf::DispatchNextTask();
	}

	return CHIP_NO_ERROR;
}

// const struct {} sensor_manager_def_include_once;

// static struct sm_trigger sensor_trigger = {
// 	.cfg = {
// 		.type = SENSOR_TRIG_MOTION,
// 		.chan = SENSOR_CHAN_ACCEL_XYZ,
// 	},
// 	.activation = {
// 		.type = ACT_TYPE_ABS,
// 		.thresh = FLOAT_TO_SENSOR_VALUE (CONFIG_ADXL362_ACTIVITY_THRESHOLD *
// 			(IS_ENABLED(CONFIG_ADXL362_ACCEL_RANGE_8G) ? 8.0 :
// 			 IS_ENABLED(CONFIG_ADXL362_ACCEL_RANGE_4G) ? 4.0 :
// 			 IS_ENABLED(CONFIG_ADXL362_ACCEL_RANGE_2G) ? 2.0 : 1/0)
// 			 / 2048.0),
// 		.timeout_ms = (CONFIG_APP_SENSOR_SLEEP_TO) * 1000
// 	}
// };

// static const struct caf_sampled_channel accel_chan[] = {
// 	{
// 		.chan = SENSOR_CHAN_ACCEL_XYZ,
// 		.data_cnt = 3,
// 	},
// };

// static const struct sm_sensor_config sensor_configs[] = {
// 	{
// 		.dev = DEVICE_DT_GET(DT_NODELABEL(adxl362)),
// 		.event_descr = CONFIG_ML_APP_SENSOR_EVENT_DESCR,
// 		.chans = accel_chan,
// 		.chan_cnt = ARRAY_SIZE(accel_chan),
// 		.sampling_period_ms = 20,
// 		.active_events_limit = 3,
// 		.trigger = &sensor_trigger,
// 	},
// };
```

## src/app_task.h
```c
/*
 * Copyright (c) 2021 Nordic Semiconductor ASA
 *
 * SPDX-License-Identifier: LicenseRef-Nordic-5-Clause
 */

#pragma once

#include "board/led_widget.h"

#include <app/clusters/identify-server/identify-server.h>
#include <platform/CHIPDeviceLayer.h>

class AppTask {
public:
	static AppTask &Instance()
	{
		static AppTask sAppTask;
		return sAppTask;
	};

	CHIP_ERROR StartApp();

	void UpdateClustersState();
	static void UpdateLedState();

private:
	CHIP_ERROR Init();

	static void MeasurementsTimerHandler();

	Nrf::LEDWidget *mRedLED;
	Nrf::LEDWidget *mGreenLED;
	Nrf::LEDWidget *mBlueLED;
};
```
