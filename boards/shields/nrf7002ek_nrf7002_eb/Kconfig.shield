## boards/shields/nrf7002ek_nrf7002_eb/Kconfig.shield
```kconfig
#
# Copyright (c) 2023 Nordic Semiconductor ASA
#
# SPDX-License-Identifier: LicenseRef-Nordic-5-Clause
#

config SHIELD_NRF7002EK_NRF7002_EB
	def_bool $(shields_list_contains,nrf7002ek_nrf7002_eb)
```

## samples/matter/bridge/Kconfig
```kconfig
#
# Copyright (c) 2023 Nordic Semiconductor
#
# SPDX-License-Identifier: LicenseRef-Nordic-5-Clause
#
mainmenu "Matter nRF Connect Bridge Example Application"

config BRIDGE_MAX_DYNAMIC_ENDPOINTS_NUMBER
	int "Maximum number of dynamic endpoints supported by the Bridge"
	default 16

config BRIDGE_ONOFF_LIGHT_BRIDGED_DEVICE
	bool "OnOff Light Bridged Device support"
	default y

config BRIDGE_TEMPERATURE_SENSOR_BRIDGED_DEVICE
	bool "Temperature Sensor Bridged Device support"
	default y

config BRIDGE_HUMIDITY_SENSOR_BRIDGED_DEVICE
	bool "Humidity Sensor Bridged Device support"
	default y

source "${ZEPHYR_BASE}/../modules/lib/matter/config/nrfconnect/chip-module/Kconfig.features"
source "${ZEPHYR_BASE}/../modules/lib/matter/config/nrfconnect/chip-module/Kconfig.defaults"
source "Kconfig.zephyr"
```

## samples/matter/bridge/sample.yaml
```yaml
sample:
  description: Matter Bridge sample
  name: Matter Bridge
tests:
  # Excluded in quarantine.yaml to limit resources usage in integration builds
  sample.matter.bridge.release:
    build_only: true
    extra_args: CONF_FILE=prj_release.conf
    integration_platforms:
      - nrf7002dk_nrf5340_cpuapp
    platform_allow: nrf7002dk_nrf5340_cpuapp
  sample.matter.bridge.debug:
    build_only: true
    integration_platforms:
      - nrf7002dk_nrf5340_cpuapp
    platform_allow: nrf7002dk_nrf5340_cpuapp
```

## samples/wifi/sr_coex/sample.yaml
```yaml
sample:
  description: Wi-Fi BLE coex sample
    application
  name: Wi-Fi BLE coex
tests:
  sample.nrf7002.ble_coex:
    build_only: true
    integration_platforms:
      - nrf7002dk_nrf5340_cpuapp
    platform_allow: nrf7002dk_nrf5340_cpuapp
    tags: ci_build
  sample.nrf7002_eb.thingy53.sr_coex:
    build_only: true
    extra_args: SHIELD=nrf7002ek_nrf7002_eb
    integration_platforms:
      - thingy53_nrf5340_cpuapp
    platform_allow: thingy53_nrf5340_cpuapp
    tags: ci_build
```
