## CMakeLists.txt
```
#
# Copyright (c) 2021 Nordic Semiconductor ASA
#
# SPDX-License-Identifier: LicenseRef-BSD-5-Clause-Nordic
#

cmake_minimum_required(VERSION 3.13.1)

get_filename_component(CHIP_ROOT ../../../../modules/lib/connectedhomeip REALPATH)
get_filename_component(COMMON_ROOT ../common REALPATH)

list(APPEND ZEPHYR_EXTRA_MODULES ${CHIP_ROOT}/config/nrfconnect/chip-module)
find_package(Zephyr HINTS $ENV{ZEPHYR_BASE})

project(chip-light-switch)

# Temporary get rid of compilation warnings till zephyrproject-rtos/zephyr/pull/31471 is fetched
zephyr_compile_options(-Wno-parentheses)

target_include_directories(app PRIVATE src ${COMMON_ROOT}/src)

target_compile_options(app PRIVATE -Wno-deprecated-declarations)

target_sources(app PRIVATE
               src/app_task.cpp
               src/light_switch.cpp
               src/main.cpp
               ${COMMON_ROOT}/src/led_widget.cpp
               ${COMMON_ROOT}/src/thread_util.cpp)
```

## prj.conf
```kconfig
#
# Copyright (c) 2021 Nordic Semiconductor ASA
#
# SPDX-License-Identifier: LicenseRef-BSD-5-Clause-Nordic
#

# Enable CHIP
CONFIG_CHIP=y
CONFIG_STD_CPP14=y

# General networking settings
CONFIG_NETWORKING=y
CONFIG_NET_IPV6_NBR_CACHE=n
CONFIG_NET_IPV6_MLD=n

# Enable OpenThread MTD
CONFIG_NET_L2_OPENTHREAD=y

CONFIG_OPENTHREAD_FTD=y
CONFIG_OPENTHREAD_SLAAC=y
CONFIG_OPENTHREAD_MTD_NETDIAG=y
CONFIG_OPENTHREAD_MANUAL_START=y
CONFIG_OPENTHREAD_THREAD_STACK_SIZE=6144

CONFIG_OPENTHREAD_PANID=4660
CONFIG_OPENTHREAD_CHANNEL=15
CONFIG_OPENTHREAD_NETWORK_NAME="OpenThread"
CONFIG_OPENTHREAD_XPANID="11:11:11:11:22:22:22:22"

# Use nrf_security
CONFIG_NORDIC_SECURITY_BACKEND=y
CONFIG_OPENTHREAD_MBEDTLS=n

CONFIG_MBEDTLS_ENABLE_HEAP=y
CONFIG_MBEDTLS_HEAP_SIZE=15360
CONFIG_MBEDTLS_TLS_LIBRARY=y
CONFIG_NRF_SECURITY_ADVANCED=y

CONFIG_MBEDTLS_AES_C=y
CONFIG_MBEDTLS_RSA_C=y
CONFIG_MBEDTLS_ECP_C=y
CONFIG_MBEDTLS_ECP_DP_SECP256R1_ENABLED=y
CONFIG_MBEDTLS_CTR_DRBG_C=y
CONFIG_MBEDTLS_CIPHER_MODE_CTR=y
CONFIG_MBEDTLS_ECJPAKE_C=y

# Disable unneeded crypto operations
CONFIG_MBEDTLS_SHA512_C=n
CONFIG_MBEDTLS_CIPHER_MODE_XTS=n
CONFIG_MBEDTLS_CHACHA20_C=n
CONFIG_MBEDTLS_POLY1305_C=n
CONFIG_MBEDTLS_CHACHAPOLY_C=n
CONFIG_MBEDTLS_GCM_C=n

# Add support for LEDs and buttons on Nordic development kits
CONFIG_DK_LIBRARY=y

# Other settings
CONFIG_LOG=y
CONFIG_LOG_MINIMAL=y
CONFIG_MAIN_STACK_SIZE=8192
CONFIG_INIT_STACKS=y
CONFIG_THREAD_NAME=y
CONFIG_MPU_STACK_GUARD=y
```

## src/main.cpp
```c
/*
 * Copyright (c) 2021 Nordic Semiconductor ASA
 *
 * SPDX-License-Identifier: LicenseRef-BSD-5-Clause-Nordic
 */

#include "app_task.h"

#include <logging/log.h>

LOG_MODULE_REGISTER(app);

int main()
{
	return GetAppTask().StartApp();
}
```

## src/app_event.h
```c
/*
 * Copyright (c) 2021 Nordic Semiconductor ASA
 *
 * SPDX-License-Identifier: LicenseRef-BSD-5-Clause-Nordic
 */

#pragma once

#include <inet/IPAddress.h>

#include <cstdint>

struct AppEvent {
	using IPAddress = chip::Inet::IPAddress;

	enum SimpleEventType : uint8_t { FactoryReset, StartDiscovery, StopDiscovery, ToggleLight };
	enum LightLevelEventType : uint8_t { SetLevel = ToggleLight + 1 };
	enum LightFoundEventType : uint8_t { LightFound = SetLevel + 1 };

	AppEvent() = default;
	explicit AppEvent(SimpleEventType type) : Type(type) {}
	AppEvent(LightLevelEventType type, uint8_t level) : Type(type), LightLevelEvent{ level } {}
	AppEvent(LightFoundEventType type, const IPAddress &addr) : Type(type), LightFoundEvent{ addr } {}

	uint8_t Type;

	union {
		struct {
			uint8_t Level;
		} LightLevelEvent;
		struct {
			IPAddress PeerAddress;
		} LightFoundEvent;
	};
};
```

## src/app_task.cpp
```c
/*
 * Copyright (c) 2021 Nordic Semiconductor ASA
 *
 * SPDX-License-Identifier: LicenseRef-BSD-5-Clause-Nordic
 */

#include "app_task.h"

#include "light_switch.h"
#include "led_widget.h"
#include "thread_util.h"

#include <platform/CHIPDeviceLayer.h>
#include <support/CHIPMem.h>
#include <support/SafeInt.h>

#include <dk_buttons_and_leds.h>
#include <logging/log.h>
#include <zephyr.h>

using namespace ::chip::DeviceLayer;

LOG_MODULE_DECLARE(app);

namespace
{
static constexpr size_t kAppEventQueueSize = 10;

K_MSGQ_DEFINE(sAppEventQueue, sizeof(AppEvent), kAppEventQueueSize, alignof(AppEvent));
LightSwitch sLightSwitch;
LEDWidget sStatusLED;
uint8_t sLightLevel = 255; /* light brightness 0-255 */
k_timer sLightLevelTimer; /* timer for increasing the light brightness while holding the button */
k_timer sDiscoveryTimeout; /* timer for stopping light bulb discovery */
} /* namespace */

AppTask AppTask::sAppTask;

int AppTask::Init()
{
	/* Initialize CHIP */

	CHIP_ERROR err = chip::Platform::MemoryInit();

	if (err != CHIP_NO_ERROR) {
		LOG_ERR("Platform::MemoryInit() failed");
		return err;
	}

	err = sLightSwitch.Init();

	if (err != CHIP_NO_ERROR)
		return err;

	err = ThreadStackMgr().InitThreadStack();

	if (err != CHIP_NO_ERROR) {
		LOG_ERR("ThreadStackMgr().InitThreadStack() failed: %s", chip::ErrorStr(err));
		return err;
	}

	err = ConnectivityMgr().SetThreadDeviceType(ConnectivityManager::kThreadDeviceType_Router);

	if (err != CHIP_NO_ERROR) {
		LOG_ERR("ConnectivityMgr().SetThreadDeviceType() failed: %s", chip::ErrorStr(err));
		return err;
	}

	/* Initialize UI components */

	LEDWidget::InitGpio();
	sStatusLED.Init(DK_LED1);

	int ret = dk_buttons_init(ButtonEventHandler);

	if (ret) {
		LOG_ERR("dk_buttons_init() failed");
		return ret;
	}

	k_timer_init(&sLightLevelTimer, AppTask::LightLevelTimerHandler, nullptr);
	k_timer_init(&sDiscoveryTimeout, AppTask::DiscoveryTimeoutHandler, nullptr);
	return 0;
}

int AppTask::StartApp()
{
	int ret = Init();

	if (ret) {
		LOG_ERR("AppTask.Init() failed");
		return ret;
	}

	AppEvent event = {};

	while (true) {
		ret = k_msgq_get(&sAppEventQueue, &event, K_MSEC(10));

		while (!ret) {
			DispatchEvent(event);
			ret = k_msgq_get(&sAppEventQueue, &event, K_NO_WAIT);
		}

		sStatusLED.Animate();
	}
}

void AppTask::PostEvent(const AppEvent &event)
{
	if (k_msgq_put(&sAppEventQueue, &event, K_NO_WAIT)) {
		LOG_INF("Failed to post event to app task event queue");
	}
}

void AppTask::DispatchEvent(const AppEvent &event)
{
	switch (event.Type) {
	case AppEvent::FactoryReset:
		LOG_INF("Factory reset triggered");
		ConfigurationMgr().InitiateFactoryReset();
		break;
	case AppEvent::StartDiscovery:
		StartDiscoveryHandler();
		break;
	case AppEvent::StopDiscovery:
		sLightSwitch.StopDiscovery();
		sStatusLED.Set(false);
		break;
	case AppEvent::ToggleLight:
		sLightSwitch.ToggleLight();
		break;
	case AppEvent::SetLevel:
		sLightSwitch.SetLightLevel(event.LightLevelEvent.Level);
		break;
	case AppEvent::LightFound:
		k_timer_stop(&sDiscoveryTimeout);
		sLightSwitch.StopDiscovery();
		sStatusLED.Set(sLightSwitch.Pair(event.LightFoundEvent.PeerAddress) == CHIP_NO_ERROR);
		break;
	default:
		LOG_INF("Unknown event received");
		break;
	}
}

void AppTask::StartDiscoveryHandler()
{
	if (!ConnectivityMgr().IsThreadProvisioned()) {
		StartDefaultThreadNetwork(/* dataset timestamp */ 1);
		LOG_INF("Device is not commissioned to a Thread network. Starting with the default configuration");
	}

	sLightSwitch.StartDiscovery();
	sStatusLED.Blink(100, 900);
	k_timer_start(&sDiscoveryTimeout, K_SECONDS(10), K_NO_WAIT);
}

void AppTask::ButtonEventHandler(uint32_t buttonsState, uint32_t hasChanged)
{
	if (DK_BTN1_MSK & buttonsState & hasChanged) {
		GetAppTask().PostEvent(AppEvent(AppEvent::FactoryReset));
	}

	if (DK_BTN2_MSK & buttonsState & hasChanged) {
		GetAppTask().PostEvent(AppEvent(AppEvent::ToggleLight));
	}

	if (DK_BTN3_MSK & buttonsState & hasChanged) {
		GetAppTask().PostEvent(AppEvent(AppEvent::StartDiscovery));
	}

	if (DK_BTN4_MSK & hasChanged & buttonsState) {
		k_timer_start(&sLightLevelTimer, K_MSEC(150), K_MSEC(150));
	} else if (DK_BTN4_MSK & hasChanged) {
		k_timer_stop(&sLightLevelTimer);
	}
}

void AppTask::LightLevelTimerHandler(k_timer *)
{
	/* The exponential formula below is used, since brightness differences become less and less
	 * visible for a human eye as the level increases. */
	const size_t newLevel = (sLightLevel + 1) * 5 / 4;
	sLightLevel = chip::CanCastTo<uint8_t>(newLevel) ? static_cast<uint8_t>(newLevel) : 0;
	GetAppTask().PostEvent(AppEvent(AppEvent::SetLevel, sLightLevel));
}

void AppTask::DiscoveryTimeoutHandler(k_timer *)
{
	GetAppTask().PostEvent(AppEvent(AppEvent::StopDiscovery));
}
```

## src/app_task.h
```c
/*
 * Copyright (c) 2021 Nordic Semiconductor ASA
 *
 * SPDX-License-Identifier: LicenseRef-BSD-5-Clause-Nordic
 */

#pragma once

#include "app_event.h"

#include <cstdint>

struct k_timer;

class AppTask {
public:
	int StartApp();
	void PostEvent(const AppEvent &event);

private:
	int Init();

	void DispatchEvent(const AppEvent &event);
	void StartDiscoveryHandler();

	static void ButtonEventHandler(uint32_t buttonsState, uint32_t hasChanged);
	static void LightLevelTimerHandler(k_timer *);
	static void DiscoveryTimeoutHandler(k_timer *);

	friend AppTask &GetAppTask();
	static AppTask sAppTask;
};

inline AppTask &GetAppTask()
{
	return AppTask::sAppTask;
}
```

## src/light_switch.cpp
```c
/*
 * Copyright (c) 2021 Nordic Semiconductor ASA
 *
 * SPDX-License-Identifier: LicenseRef-BSD-5-Clause-Nordic
 */

#include "light_switch.h"

#include "app_task.h"

#include <platform/CHIPDeviceLayer.h>
#include <app/chip-zcl-zpro-codec.h>
#include <support/ErrorStr.h>

#include <logging/log.h>
#include <net/net_ip.h>

LOG_MODULE_DECLARE(app);

namespace
{
static constexpr chip::EndpointId kLightBulbEndpointId = 1;
static constexpr uint16_t kDiscoveryPort = 12345;
static constexpr const char kDiscoveryMagicString[] = "chip-light-bulb";

void OnLightBulbDiscoveryMessage(const chip::PacketHeader &header, const chip::Transport::PeerAddress &source,
				 chip::System::PacketBufferHandle msgBuf, LightSwitch *thisPtr)
{
	if (!thisPtr->IsDiscoveryEnabled()) {
		return;
	}

	if (msgBuf->DataLength() != sizeof(kDiscoveryMagicString) ||
	    memcmp(msgBuf->Start(), kDiscoveryMagicString, sizeof(kDiscoveryMagicString)) != 0) {
		LOG_ERR("Discovery service received invalid message");
		return;
	}

	GetAppTask().PostEvent(AppEvent(AppEvent::LightFound, source.GetIPAddress()));
}
} /* namespace */

CHIP_ERROR LightSwitch::Init()
{
	CHIP_ERROR err = mCommissioner.Init(chip::kTestControllerNodeId, nullptr, nullptr);

	if (err != CHIP_NO_ERROR) {
		LOG_ERR("DeviceCommissioner::Init() failed: %s", chip::ErrorStr(err));
		return err;
	}

	err = mCommissioner.ServiceEvents();

	if (err != CHIP_NO_ERROR) {
		LOG_ERR("DeviceCommissioner::ServiceEvents() failed: %s", chip::ErrorStr(err));
		return err;
	}

	auto params = chip::Transport::UdpListenParameters(&chip::DeviceLayer::InetLayer).SetListenPort(kDiscoveryPort);
	err = mDiscoveryServiceEndpoint.Init(params);

	if (err != CHIP_NO_ERROR) {
		LOG_ERR("Transport::UDP::Init() failed: %s", chip::ErrorStr(err));
		return err;
	}

	mDiscoveryEnabled.store(true, std::memory_order_relaxed);
	mDiscoveryServiceEndpoint.SetMessageReceiveHandler(OnLightBulbDiscoveryMessage, this);
	return CHIP_NO_ERROR;
}

void LightSwitch::StartDiscovery()
{
	LOG_INF("Starting light bulb discovery");
	mDiscoveryEnabled.store(true, std::memory_order_relaxed);
}

void LightSwitch::StopDiscovery()
{
	LOG_INF("Stopping light bulb discovery");
	mDiscoveryEnabled.store(false, std::memory_order_relaxed);
}

bool LightSwitch::IsDiscoveryEnabled() const
{
	return mDiscoveryEnabled.load(std::memory_order_relaxed);
}

CHIP_ERROR LightSwitch::Pair(const chip::Inet::IPAddress &lightBulbAddress)
{
	{
		char addrStr[NET_IPV6_ADDR_LEN];
		LOG_INF("Pairing with light bulb %s", lightBulbAddress.ToString(addrStr, NET_IPV6_ADDR_LEN));
	}

	CHIP_ERROR err = CHIP_NO_ERROR;

	{
		chip::Controller::SerializedDevice serializedDevice;
		err = mCommissioner.PairTestDeviceWithoutSecurity(chip::kTestDeviceNodeId, lightBulbAddress,
								  serializedDevice, CHIP_PORT);
	}

	if (err != CHIP_NO_ERROR)
		LOG_ERR("Pairing failed: %s", chip::ErrorStr(err));

	return err;
}

CHIP_ERROR LightSwitch::ToggleLight()
{
	LOG_INF("Toggling the light");

	chip::Controller::Device *device;
	CHIP_ERROR err = mCommissioner.GetDevice(chip::kTestDeviceNodeId, &device);

	if (err != CHIP_NO_ERROR) {
		LOG_ERR("No light bulb device is paired");
		return err;
	}

	auto buffer = encodeOnOffClusterToggleCommand(kLightBulbEndpointId);
	if (buffer.IsNull()) {
		return CHIP_ERROR_NO_MEMORY;
	}

	return device->SendMessage(std::move(buffer));
}

CHIP_ERROR LightSwitch::SetLightLevel(uint8_t level)
{
	LOG_INF("Setting brightness level to %u", level);

	chip::Controller::Device *device;
	CHIP_ERROR err = mCommissioner.GetDevice(chip::kTestDeviceNodeId, &device);

	if (err != CHIP_NO_ERROR) {
		LOG_ERR("No light bulb device is paired");
		return err;
	}

	auto buffer = encodeLevelControlClusterMoveToLevelCommand(kLightBulbEndpointId, level, 0, 0, 0);
	if (buffer.IsNull()) {
		return CHIP_ERROR_NO_MEMORY;
	}

	return device->SendMessage(std::move(buffer));
}
```

## src/light_switch.h
```c
/*
 * Copyright (c) 2021 Nordic Semiconductor ASA
 *
 * SPDX-License-Identifier: LicenseRef-BSD-5-Clause-Nordic
 */

#pragma once

#include <controller/CHIPDeviceController.h>
#include <transport/raw/UDP.h>

#include <atomic>

/** @class LightSwitch
 *  @brief Class for controlling a CHIP light bulb over a Thread network
 *
 *  Features:
 *  - discovering a CHIP light bulb which advertises itself by sending Thread multicast packets
 *  - toggling and dimming the connected CHIP light bulb by sending appropriate CHIP messages
 */
class LightSwitch {
public:
	CHIP_ERROR Init();

	void StartDiscovery();
	void StopDiscovery();
	bool IsDiscoveryEnabled() const;

	CHIP_ERROR Pair(const chip::Inet::IPAddress &lightBulbAddress);
	CHIP_ERROR ToggleLight();
	CHIP_ERROR SetLightLevel(uint8_t level);

private:
	chip::Transport::UDP mDiscoveryServiceEndpoint;
	chip::Controller::DeviceCommissioner mCommissioner;
	std::atomic_bool mDiscoveryEnabled;
};
```
