## sample.yaml
```
sample:
  name: OpenThread CLI sample
  description: Test OpenThread Command Line Interface.

tests:
  sample.openthread.cli:
    sysbuild: true
    build_only: true
    tags:
      - ci_build
      - sysbuild
      - ci_samples_openthread
    platform_allow:
      - nrf52840dk/nrf52840
      - nrf52840dongle/nrf52840
      - nrf21540dk/nrf52840
      - nrf5340dk/nrf5340/cpuapp
      - nrf54l15dk/nrf54l15/cpuapp
      - nrf54l15dk/nrf54l10/cpuapp
      - nrf54l15dk/nrf54l15/cpuapp/ns
      - nrf54lm20dk/nrf54lm20b/cpuapp
      - nrf54lm20dk/nrf54lm20a/cpuapp
      - nrf54lv10dk/nrf54lv10a/cpuapp
    integration_platforms:
      - nrf52840dk/nrf52840
      - nrf52840dongle/nrf52840
      - nrf21540dk/nrf52840
      - nrf5340dk/nrf5340/cpuapp
      - nrf54l15dk/nrf54l15/cpuapp
      - nrf54l15dk/nrf54l10/cpuapp
      - nrf54l15dk/nrf54l15/cpuapp/ns
      - nrf54lm20dk/nrf54lm20b/cpuapp
      - nrf54lm20dk/nrf54lm20a/cpuapp
      - nrf54lv10dk/nrf54lv10a/cpuapp
  sample.openthread.cli.multiprotocol:
    sysbuild: true
    build_only: true
    tags:
      - ci_build
      - sysbuild
      - ci_samples_openthread
    platform_allow:
      - nrf52840dk/nrf52840
      - nrf52840dongle/nrf52840
      - nrf21540dk/nrf52840
      - nrf5340dk/nrf5340/cpuapp
      - nrf54l15dk/nrf54l15/cpuapp
      - nrf54l15dk/nrf54l10/cpuapp
      - nrf54l15dk/nrf54l15/cpuapp/ns
      - nrf54lm20dk/nrf54lm20b/cpuapp
      - nrf54lm20dk/nrf54lm20a/cpuapp
    extra_args:
      - cli_SNIPPET="ot-ci;ot-logging"
      - EXTRA_CONF_FILE="extra_conf/multiprotocol.conf;extra_conf/tcp.conf"
      - CONFIG_OTPERF=y
      - FILE_SUFFIX=ble
    integration_platforms:
      - nrf52840dk/nrf52840
      - nrf52840dongle/nrf52840
      - nrf21540dk/nrf52840
      - nrf5340dk/nrf5340/cpuapp
      - nrf54l15dk/nrf54l15/cpuapp
      - nrf54l15dk/nrf54l10/cpuapp
      - nrf54l15dk/nrf54l15/cpuapp/ns
      - nrf54lm20dk/nrf54lm20b/cpuapp
      - nrf54lm20dk/nrf54lm20a/cpuapp
  sample.openthread.cli.singleprotocol:
    sysbuild: true
    build_only: true
    tags:
      - ci_build
      - sysbuild
      - ci_samples_openthread
    platform_allow:
      - nrf52840dk/nrf52840
      - nrf21540dk/nrf52840
      - nrf5340dk/nrf5340/cpuapp
      - nrf54l15dk/nrf54l15/cpuapp
      - nrf54l15dk/nrf54l10/cpuapp
      - nrf54l15dk/nrf54l15/cpuapp/ns
      - nrf54lm20dk/nrf54lm20b/cpuapp
      - nrf54lm20dk/nrf54lm20a/cpuapp
    extra_args:
      - cli_SNIPPET="ot-ci;ot-logging"
      - EXTRA_CONF_FILE=extra_conf/tcp.conf
      - CONFIG_OTPERF=y
    integration_platforms:
      - nrf52840dk/nrf52840
      - nrf21540dk/nrf52840
      - nrf5340dk/nrf5340/cpuapp
      - nrf54l15dk/nrf54l15/cpuapp
      - nrf54l15dk/nrf54l10/cpuapp
      - nrf54l15dk/nrf54l15/cpuapp/ns
      - nrf54lm20dk/nrf54lm20b/cpuapp
      - nrf54lm20dk/nrf54lm20a/cpuapp
  sample.openthread.cli.usb:
    sysbuild: true
    build_only: true
    tags:
      - ci_build
      - sysbuild
      - ci_samples_openthread
    platform_allow:
      - nrf52840dk/nrf52840
      - nrf21540dk/nrf52840
      - nrf5340dk/nrf5340/cpuapp
    extra_args:
      - cli_SNIPPET="ot-ci;ot-logging;ot-usb"
      - EXTRA_CONF_FILE="extra_conf/multiprotocol.conf;extra_conf/tcp.conf"
      - FILE_SUFFIX=ble
    integration_platforms:
      - nrf52840dk/nrf52840
      - nrf21540dk/nrf52840
      - nrf5340dk/nrf5340/cpuapp
  sample.openthread.cli.low_power:
    sysbuild: true
    build_only: true
    tags:
      - ci_build
      - sysbuild
      - ci_samples_openthread
    platform_allow:
      - nrf52840dk/nrf52840
      - nrf5340dk/nrf5340/cpuapp
      - nrf54l15dk/nrf54l15/cpuapp
      - nrf54lm20dk/nrf54lm20b/cpuapp
      - nrf54lm20dk/nrf54lm20a/cpuapp
    extra_args:
      - cli_SNIPPET="ot-ci"
      - EXTRA_CONF_FILE=extra_conf/low_power.conf
      - CONFIG_OTPERF=y
    integration_platforms:
      - nrf52840dk/nrf52840
      - nrf5340dk/nrf5340/cpuapp
      - nrf54l15dk/nrf54l15/cpuapp
      - nrf54lm20dk/nrf54lm20b/cpuapp
      - nrf54lm20dk/nrf54lm20a/cpuapp
  # Build integration regression protection.
  sample.nrf_security.openthread.integration:
    sysbuild: true
    build_only: true
    tags:
      - sysbuild
      - ci_samples_openthread
    platform_allow:
      - nrf52840dk/nrf52840
    extra_args:
      - cli_SNIPPET=ot-ci
      - CONFIG_NRF_SECURITY=y
    integration_platforms:
      - nrf52840dk/nrf52840
  sample.openthread.cli.tcat:
    sysbuild: true
    build_only: true
    tags:
      - ci_build
      - sysbuild
      - ci_samples_openthread
    platform_allow:
      - nrf52840dk/nrf52840
      - nrf21540dk/nrf52840
      - nrf5340dk/nrf5340/cpuapp
      - nrf54l15dk/nrf54l15/cpuapp
      - nrf54l15dk/nrf54l10/cpuapp
      - nrf54l15dk/nrf54l15/cpuapp/ns
    extra_args:
      - cli_SNIPPET="ot-ci"
      - EXTRA_CONF_FILE=extra_conf/tcat.conf
      - EXTRA_CONF_FILE=extra_conf/tcp.conf
      - CONFIG_OTPERF=y
      - FILE_SUFFIX=ble
    integration_platforms:
      - nrf52840dk/nrf52840
      - nrf21540dk/nrf52840
      - nrf5340dk/nrf5340/cpuapp
      - nrf54l15dk/nrf54l15/cpuapp
      - nrf54l15dk/nrf54l10/cpuapp
      - nrf54l15dk/nrf54l15/cpuapp/ns
  sample.openthread.cli.diag_gpio:
    sysbuild: true
    build_only: true
    tags:
      - ci_build
      - sysbuild
      - ci_samples_openthread
    platform_allow:
      - nrf52840dk/nrf52840
      - nrf5340dk/nrf5340/cpuapp
      - nrf54l15dk/nrf54l15/cpuapp
      - nrf54l15dk/nrf54l10/cpuapp
      - nrf54l15dk/nrf54l15/cpuapp/ns
    extra_args: >
      cli_SNIPPET="ot-diag-gpio"
    integration_platforms:
      - nrf52840dk/nrf52840
      - nrf5340dk/nrf5340/cpuapp
      - nrf54l15dk/nrf54l15/cpuapp
      - nrf54l15dk/nrf54l10/cpuapp
      - nrf54l15dk/nrf54l15/cpuapp/ns
  sample.openthread.cli.l2:
    sysbuild: true
    build_only: true
    tags:
      - ci_build
      - sysbuild
      - ci_samples_openthread
    platform_allow:
      - nrf52840dk/nrf52840
      - nrf5340dk/nrf5340/cpuapp
      - nrf54l15dk/nrf54l15/cpuapp
      - nrf54l15dk/nrf54l10/cpuapp
      - nrf54lm20dk/nrf54lm20b/cpuapp
      - nrf54lm20dk/nrf54lm20a/cpuapp
      - nrf54l15dk/nrf54l15/cpuapp/ns
    extra_args:
      - cli_SNIPPET="ot-ci;ot-zephyr-l2"
    integration_platforms:
      - nrf52840dk/nrf52840
      - nrf5340dk/nrf5340/cpuapp
      - nrf54l15dk/nrf54l15/cpuapp
      - nrf54l15dk/nrf54l10/cpuapp
      - nrf54lm20dk/nrf54lm20b/cpuapp
      - nrf54lm20dk/nrf54lm20a/cpuapp
      - nrf54l15dk/nrf54l15/cpuapp/ns
  sample.openthread.cli.multiprotocol.l2:
    sysbuild: true
    build_only: true
    tags:
      - ci_build
      - sysbuild
      - ci_samples_openthread
    platform_allow:
      - nrf52840dk/nrf52840
      - nrf5340dk/nrf5340/cpuapp
      - nrf54l15dk/nrf54l15/cpuapp
      - nrf54l15dk/nrf54l10/cpuapp
      - nrf54lm20dk/nrf54lm20b/cpuapp
      - nrf54lm20dk/nrf54lm20a/cpuapp
      - nrf54l15dk/nrf54l15/cpuapp/ns
    extra_args:
      - cli_SNIPPET="ot-logging;ot-zephyr-l2;zperf"
      - EXTRA_CONF_FILE="extra_conf/l2_logging.conf;extra_conf/multiprotocol.conf"
      - FILE_SUFFIX=ble
    integration_platforms:
      - nrf52840dk/nrf52840
      - nrf5340dk/nrf5340/cpuapp
      - nrf54l15dk/nrf54l15/cpuapp
      - nrf54l15dk/nrf54l10/cpuapp
      - nrf54lm20dk/nrf54lm20b/cpuapp
      - nrf54lm20dk/nrf54lm20a/cpuapp
      - nrf54l15dk/nrf54l15/cpuapp/ns
```

## prj.conf
```kconfig
#
# Copyright (c) 2020 Nordic Semiconductor
#
# SPDX-License-Identifier: LicenseRef-BSD-5-Clause-Nordic
#

# Logging
CONFIG_OT_COMMAND_LINE_INTERFACE_LOG_LEVEL_DBG=y
CONFIG_NET_CONFIG_LOG_LEVEL_INF=y

# Network shell
CONFIG_NET_SHELL=y
CONFIG_SHELL_ARGC_MAX=26
CONFIG_SHELL_CMD_BUFF_SIZE=416

# Enable OpenThread features set
CONFIG_OPENTHREAD_NORDIC_LIBRARY_MASTER=y

CONFIG_OBERON_BACKEND=n
CONFIG_CC3XX_BACKEND=y
```

## src/main.c
```c
/*
 * Copyright (c) 2020 Nordic Semiconductor ASA
 *
 * SPDX-License-Identifier: LicenseRef-BSD-5-Clause-Nordic
 */
#include <zephyr.h>
#include <logging/log.h>
#include <mbedtls/pkcs5.h>

LOG_MODULE_REGISTER(cli_sample, CONFIG_OT_COMMAND_LINE_INTERFACE_LOG_LEVEL);

#define WELLCOME_TEXT \
	"\n\r"\
	"\n\r"\
	"OpenThread Command Line Interface is now running.\n\r" \
	"Use the 'ot' keyword to invoke OpenThread commands e.g. " \
	"'ot thread start.'\n\r" \
	"For the full commands list refer to the OpenThread CLI " \
	"documentation at:\n\r" \
	"https://github.com/openthread/openthread/blob/master/src/cli/README.md\n\r"


void main(void)
{
	LOG_INF(WELLCOME_TEXT);

    const mbedtls_md_info_t * md_info;
    mbedtls_md_context_t md_ctxt;
    int use_hmac = 1;

    bool free_md_ctxt = false;

    md_info = mbedtls_md_info_from_type(MBEDTLS_MD_SHA256);

    mbedtls_md_init(&md_ctxt);
    free_md_ctxt = true;

    mbedtls_md_setup(&md_ctxt, md_info, use_hmac);

	static const char * salt = "abcdefghijklmnopqrstuvwyz";
	const uint8_t saltLength = 25;
	uint32_t password = 1234;
	static uint8_t out[2][40];
	const uint8_t keyLength = 80;
	const uint16_t iterationsNumber = 4096;

	uint32_t startTime = k_cycle_get_32();	
    mbedtls_pkcs5_pbkdf2_hmac(&md_ctxt, (uint8_t*)(&password), sizeof(password), salt, saltLength,
                                       iterationsNumber, keyLength, &out[0][0]);
	uint32_t stopTime = k_cycle_get_32();

	LOG_INF("mbedtls_pkcs5_pbkdf2_hmac calculation time: %d ms", (stopTime-startTime)/(sys_clock_hw_cycles_per_sec()/1000));

    if (free_md_ctxt)
    {
        mbedtls_md_free(&md_ctxt);
    }
}
```
